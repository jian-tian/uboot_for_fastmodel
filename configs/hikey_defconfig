## configs/hikey_defconfig
```kconfig
CONFIG_ARM=y
CONFIG_SYS_MALLOC_F_LEN=0x2000
CONFIG_HUSH_PARSER=n
# CONFIG_CMD_IMLS is not set
CONFIG_CMD_MMC=n
CONFIG_CMD_USB=n
CONFIG_CMD_GPIO=n
CONFIG_CMD_DHCP=n
CONFIG_CMD_MII=n
CONFIG_CMD_PING=n
CONFIG_CMD_CACHE=n
CONFIG_CMD_EXT2=y
CONFIG_CMD_EXT4=y
CONFIG_CMD_FAT=y
CONFIG_CMD_FS_GENERIC=y
CONFIG_OF_LIBFDT=y
CONFIG_DEFAULT_DEVICE_TREE="hi6220-hikey"
```
