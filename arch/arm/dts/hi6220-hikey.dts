/*
 * dts file for Hisilicon HiKey Development Board
 *
 * Copyright (C) 2015, Hisilicon Ltd.
 *
 */

/dts-v1/;

/*Reserved 1MB memory for MCU*/
/memreserve/ 0x05e00000 0x00100000;

#include "hi6220.dtsi"

/ {
	model = "HiKey Development Board";
	compatible = "hisilicon,hi6220-hikey", "hisilicon,hi6220";

	aliases {
		serial0 = &uart0; /* On board UART0 */
	};

	chosen {
		stdout-path = "serial0:115200n8";
		bootargs = "console=ttyAMA0, 115200 earlycon=pl011,0x12000000 loglevel=9 root=/dev/ram0  rdinit=/init initcall_debug=y";
		linux,initrd-start = <0x60800000>;
		linux,initrd-end = <0x60B52203>;
		/*linux,initrd-end = <0x6180B26B>;*/
	};

	memory@0 {
		device_type = "memory";
		reg = <0x00000000 0x40000000 0x0 0xC0000000>;
	};
};

